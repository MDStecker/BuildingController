## boards/shields/my_controller/Kconfig.defconfig
```kconfig
if SHIELD_MY_CONTROLLER

config ZMK_KEYBOARD_NAME
    default "My MF Controller"

CONFIG_BT_DEVICE_NAME="My MF Controller"
endif
```

## config/west.yml
```yaml
manifest:
  defaults:
    revision: v0.3

  remotes:
    - name: MDStecker
      url-base: https://github.com/MDStecker
    - name: badjeff
      url-base: https://github.com/badjeff

  projects:
    - name: zmk
      remote: zmkfirmware
      import: app/west.yml

    - name: zmk-analog-input-driver
      remote: MDStecker
      revision: main


  self:
    path: config
```
